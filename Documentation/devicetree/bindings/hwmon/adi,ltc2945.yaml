## Documentation/devicetree/bindings/hwmon/adi,ltc2945.yaml
```yaml
# SPDX-License-Identifier: (GPL-2.0-only OR BSD-2-Clause)
%YAML 1.2
---
$id: http://devicetree.org/schemas/hwmon/adi,ltc2945.yaml#
$schema: http://devicetree.org/meta-schemas/core.yaml#

title: Linear Technology LTC2945 Wide Range I2C Power Monitor

maintainers:
  - Guenter Roeck <linux@roeck-us.net>

description: |
  The LTC2945  is a rail-to-rail system monitor that measures current, voltage,
  and power consumption.

properties:
  compatible:
    enum:
      - adi,ltc2945

  reg:
    maxItems: 1

  shunt-resistor-micro-ohms:
    description:
      The value of curent sense resistor in microohms. If not provided,
      a default value of 1000 microohms is used.
    default: 1000

required:
  - compatible
  - reg

additionalProperties: false

examples:
  - |
    i2c {
           #address-cells = <1>;
           #size-cells = <0>;

           ltc2945_i2c: ltc2945@6f {
                   compatible = "adi,ltc2945";
                   reg = <0x6f>;

                   shunt-resistor-micro-ohms = <20000>;
           };
    };
...
```

## Documentation/devicetree/bindings/iio/fingerprint/adi,adux1060.yaml
```yaml
# SPDX-License-Identifier: GPL-2.0
%YAML 1.2
---
$id: http://devicetree.org/schemas/iio/frequency/adf4371.yaml#
$schema: http://devicetree.org/meta-schemas/core.yaml#

title: Analog Devices ADUX1060 Fingerprint Imaging Sensor

maintainers:
  - Popa Stefan <stefan.popa@analog.com>

description: |
  Analog Devices ADUX1060 Fingerprint Imaging Sensor

properties:
  compatible:
    enum:
      - adi,adux1060

  reg:
    maxItems: 1

  spi-cpha: true

  interrupts:
    maxItems: 1

  reset-gpios:
    description: GPIO connected to the RESET line
    maxItems: 1

  adi,cs-gpios:
    description: GPIO connected to the chip select lin
    maxItems: 1

required:
  - compatible
  - reg
  - interrupts
  - reset-gpios
  - adi,cs-gpios

examples:
  - |
    #include <dt-bindings/gpio/gpio.h>
    spi0 {
        #address-cells = <1>;
        #size-cells = <0>;

        fingerprint@0 {
                compatible = "adi,adux1060";
                reg = <0>;
                spi-max-frequency = <1000000>;
                spi-cpha;
                reset-gpios = <&gpio 17 GPIO_ACTIVE_LOW>;
                adi,cs-gpios = <&gpio 26 GPIO_ACTIVE_LOW>;
                interrupts = <25 1>;
                interrupt-parent = <&gpio>
        };
    };
...
```

## Documentation/devicetree/bindings/iio/frequency/adi,adf4360.yaml
```yaml
# SPDX-License-Identifier: GPL-2.0
# Copyright 2019-2020 Edward Kigwana
%YAML 1.2
---
$id: http://devicetree.org/schemas/iio/frequency/adi,adf4360.yaml#
$schema: http://devicetree.org/meta-schemas/core.yaml#

title: Analog Devices ADF4360 PLL device driver

maintainers:
  - Lars-Peter Clausen <lars@metafoo.de>
  - Edward Kigwana <ekigwana@gmail.com>

description: |
  Bindings for the Analog Devices ADF4360 family of clock generator phase-locked
  loop (PLL) devices with an integrated voltage-controlled oscillator (VCO).
  Each of the parts in the family supports a specific frequency range.
  Datasheets can be found here:
  https://www.analog.com/media/en/technical-documentation/data-sheets/ADF4360-0.pdf
  https://www.analog.com/media/en/technical-documentation/data-sheets/ADF4360-1.pdf
  https://www.analog.com/media/en/technical-documentation/data-sheets/ADF4360-2.pdf
  https://www.analog.com/media/en/technical-documentation/data-sheets/ADF4360-3.pdf
  https://www.analog.com/media/en/technical-documentation/data-sheets/ADF4360-4.pdf
  https://www.analog.com/media/en/technical-documentation/data-sheets/ADF4360-5.pdf
  https://www.analog.com/media/en/technical-documentation/data-sheets/ADF4360-6.pdf
  https://www.analog.com/media/en/technical-documentation/data-sheets/ADF4360-7.pdf
  https://www.analog.com/media/en/technical-documentation/data-sheets/ADF4360-8.pdf
  https://www.analog.com/media/en/technical-documentation/data-sheets/ADF4360-9.pdf

properties:
  compatible:
    pattern: '^adi,adf4360-[0-9]$'

  reg:
    maxItems: 1

  clocks:
    maxItems: 1

  clock-names:
    items:
      - const: clkin

  '#clock-cells':
    const: 0

  adi,loop-filter-pfd-frequency-hz:
    description: |
      The phase-frequency-detector frequency that the external loop filter was
      designed for.
    allOf:
      - minimum: 25000
      - maximum: 8000000
    maxItems: 1

  adi,loop-filter-charger-pump-current-microamp:
    description: |
      The charge pump current that the external loop filter was designed for.
      The provided value is clamped to the closest enumerated value.
    enum: [ 310, 620, 930, 1250, 1560, 1870, 2180, 2500 ]

  adi,vco-minimum-frequency-hz:
    description: |
      Required for ADF4360-7, ADF4360-8 and ADF4360-9. Minimum VCO frequency
      that can be supported by the tuning range set by the external inductor.
    maxItems: 1

  adi,vco-maximum-frequency-hz:
    description: |
      Required for ADF4360-7, ADF4360-8 and ADF4360-9. Maximum VCO frequency
      that can be supported by the tuning range set by the external inductor.
    maxItems: 1

  adi,loop-filter-inverting:
    description: Indicates that the external loop filter is an inverting filter.
    type: boolean

  adi,power-up-frequency-hz:
    description: |
      PLL tunes to the set frequency on probe or defaults to either the minimum
      for the part or value set using adi,vco-minimum-frequency-hz.
    maxItems: 1

  vdd-supply:
    description: |
      vdd supply is used to enable or disable chip when regulator power down
      mode is set. Other power down modes are used to mitigate the case of a
      shared regulator.

  enable-gpios:
    description: |
      Chip enable gpio is used to enable or disable chip when chip enable power
      down mode is set.
    maxItems: 1

  adi,muxout-gpios:
    description: |
      MUX out gpio is used to detect chip and test pll lock state on read when
      muxout control is set to lock detect.
    maxItems: 1

  adi,power-out-level-microamp:
    description: |
      Chip support setting of output power level. This property is optional.
      If it is not provided by default 11000 uA will be set.
    enum: [ 3500, 5000, 7500, 11000 ]

required:
  - compatible
  - reg
  - clocks
  - clock-names
  - adi,loop-filter-charge-pump-current
  - adi,loop-filter-pfd-frequency-hz

examples:
  - |
      spi0 {
          #address-cells = <1>;
          #size-cells = <0>;

          pll@0 {
                  compatible = "adi,adf4360-7";
                  reg = <0>;
                  spi-max-frequency = <2000000>;
                  clocks = <&ref_clock>;
                  #clock-cells = <0>;
                  clock-names = "clkin";
                  clock-output-names = "adf4360-7";

                  adi,loop-filter-charge-pump-current = <5>;
                  adi,loop-filter-pfd-frequency-hz = <2500000>;
                  adi,vco-minimum-frequency-hz = <700000000>;
                  adi,vco-maximum-frequency-hz = <840000000>;
          };
      };
...
```

## Documentation/devicetree/bindings/net/adi,adin.txt
```
Analog Devices ADIN1200/ADIN1300 PHY bindings

Required properties:
	- reg - The ID number for the phy, usually a small integer

Optional properties:
	- compatible: Compatible list, may contain "ethernet-phy-ieee802.3-c45"
		in which case Clause 45 will be used to access device
		management registers. If unspecified, Clause 22 will be used.
		Use this only when MDIO supports Clause 45 access, but there is
		no other way to determine this.
	- phy-mode-internal: The internal mode of the PHY. This assumes that there
		is a PHY converter in-between the MAC & PHY.
		Valid values are: "rgmii", "rgmii-id", "rgmii-txid", "rgmii-rxid",
		"rmii", "mii"

Example:

	ethernet-phy@0 {
		compatible = "ethernet-phy-ieee802.3-c45";
		reg = <0>;
	};
```

## drivers/iio/dummy/Kconfig
```kconfig
# SPDX-License-Identifier: GPL-2.0-only
#
# Industrial I/O subsystem Dummy Driver configuration
#
menu "IIO dummy driver"
	depends on IIO

config IIO_DUMMY_EVGEN
	select IRQ_SIM
	tristate

config IIO_SIMPLE_DUMMY
	tristate "An example driver with no hardware requirements"
	depends on IIO_SW_DEVICE
	help
	  Driver intended mainly as documentation for how to write
	  a driver. May also be useful for testing userspace code
	  without hardware.

if IIO_SIMPLE_DUMMY

config IIO_SIMPLE_DUMMY_EVENTS
	bool "Event generation support"
	select IIO_DUMMY_EVGEN
	help
	  Add some dummy events to the simple dummy driver.

	  The purpose of this is to generate 'fake' event interrupts thus
	  allowing that driver's code to be as close as possible to that
	  a normal driver talking to hardware.

config IIO_SIMPLE_DUMMY_BUFFER
	bool "Buffered capture support"
	select IIO_BUFFER
	select IIO_TRIGGER
	select IIO_KFIFO_BUF
	help
	  Add buffered data capture to the simple dummy driver.

choice
	prompt "Buffer type"
	default IIO_SIMPLE_DUMMY_BUFFER_KFIFO
	depends on IIO_SIMPLE_DUMMY_BUFFER
	help
	  Select the type of the buffer used by the simple dummy driver.
	  Can either be KFIFO or DMA.

config IIO_SIMPLE_DUMMY_BUFFER_KFIFO
	bool "Triggered FIFO"
	select IIO_TRIGGER
	select IIO_KFIFO_BUF
	help
	  Triggered buffer utilizing a software FIFO where a software routine is
	  responsible for transferring data between the converter and the FIFO.

	  No real hardware is used for the dummy driver and the converter is
	  emulated by software.

config IIO_SIMPLE_DUMMY_BUFFER_DMA
	bool "DMA"
	depends on HAS_DMA
	select IIO_BUFFER_DMA
	help
	  DMA buffer where a DMA controller is responsible for transferring data
	  between the data and the buffers memory region.

	  No real hardware is used for the dummy driver and the converter as well as
	  the DMA controller are emulated by software.

endchoice

endif # IIO_SIMPLE_DUMMY

endmenu
```

## drivers/iio/fingerprint/Kconfig
```kconfig
#
# Fingerprint Sensors
#

menu "Fingerprint Sensors"

config ADUX1060
	tristate "ADUX1060 Fingerprint Scanner"
	depends on SPI
	help
	  Say Y here to build SPI interface support for the ADUX1060
	  Fingerprint scannner sensor

endmenu
```

## drivers/iio/logic/Kconfig
```kconfig
#
# Logi Analyzer drivers
#
# When adding new entries keep the list in alphabetical order

menu "Logic Analyzers"

config ADI_M2K_LOGIC_ANALYZER
	tristate "M2k Logic Analyzer support"
	select ADI_M2K_TRIGGER_ADC
	help
	  Support for the Logic Analyzer module on the Analog Devices
	  ADALM-2000 (M2k) platform.

endmenu
```
